## boards/arm/plotter_f405rg/Kconfig.board
```kconfig
config BOARD_PLOTTER_F405RG
	bool "zephyr-grbl-plotter controller board"
	depends on SOC_STM32F405XG
```

## boards/arm/plotter_f405rg/Kconfig.defconfig
```kconfig
if BOARD_PLOTTER_F405RG

config BOARD
	default "plotter_f405rg"

config SPI_STM32_INTERRUPT
	default y
	depends on SPI

endif
```

## modules/hw_timer/dts/bindings/hw_timer/st,stm32-hw-timer.yaml
```yaml
description: STM32 Hardware Timer with a callback

compatible: "st,stm32-hw-timer"

include: [pwm-controller.yaml, base.yaml]

properties:
  label:
    deprecated: true

  st,prescaler:
    type: int
    required: true
    description: Clock prescaler at the input of the timer

  pinctrl-0:
    type: phandles
    required: false
    description: |
      GPIO pin configuration for PWM signal/s. We expect that the phandles
      will reference pinctrl nodes, e.g.

         pinctrl-0 = <&tim1_ch1_pwm_pa8 &tim1_ch2_pwm_pa9>;

  "#pwm-cells":
    const: 3

pwm-cells:
  - channel
  # period in terms of nanoseconds
  - period
  - flags
```

## modules/hw_timer/zephyr/Kconfig
```kconfig
# Copyright (c) 2021 lukasz.iwaszkiewicz@gmail.com
# SPDX-License-Identifier: Apache-2.0

config HW_TIMER_DRIVER
	bool "Enable support for the hardware timer with callback driver"

if HW_TIMER_DRIVER
module = HW_TIMER
module-str = hw_timer

source "subsys/logging/Kconfig.template.log_config"
endif
```
